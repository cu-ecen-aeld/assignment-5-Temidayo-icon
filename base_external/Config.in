## base_external/Config.in
```kconfig
menu "External options"

source "/home/temidayo/Assignment-4/assignment-4-Temidayo-icon/base_external/package/aesd-assignments/Config.in"


endmenu
```

## base_external/package/aesd-assignments/Config.in
```kconfig
config BR2_PACKAGE_AESD_ASSIGNMENTS
	bool "aesd-assignments"
	depends on BR2_PACKAGE_HOST_GIT
	help
	  AESD assignments package including:
	  - finder-app utilities (writer, finder.sh, finder-test.sh)
	  - aesdsocket TCP server (port 9000 with daemon startup script)
	  
	  This package provides file manipulation utilities and a socket-based
	  server application for the AESD course assignments.
```
